## app/drivers/zephyr/dts/bindings/sensor/pimoroni,trackball_pim447.yaml
```yaml
# Copyright (c) 2021 The ZMK Contributors
# SPDX-License-Identifier: MIT

description: Trackball PIM447

compatible: "pimoroni,trackball_pim447"

properties:
  label:
    type: string
    required: true

  reg:
    type: int
    required: true

  move-factor:
    type: int
    required: false
    default: 1

  int-gpios:
    type: phandle-array
    # TODO false
    required: true
    description: Interrupt pin.

      The interrupt pin is open-drain, active low.
      If connected directly the MCU pin should be configured
      as pull-up, active low.

  invert-move-x:
    type: boolean
    required: false

  invert-move-y:
    type: boolean
    required: false

  button:
    type: int
    required: false
    default: 0

  swap-axes:
    type: boolean
    required: false

  scroll-divisor:
    type: int
    required: false
    default: 2

  invert-scroll-x:
    type: boolean
    required: false

  invert-scroll-y:
    type: boolean
    required: false

  mode:
    type: int
    required: false
    default: 1
    enum:
      - 1
      - 2
```
